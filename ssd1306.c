#include "ssd1306.h"
#include <string.h>
#include <stdio.h>
#include <stdarg.h>
#include "esp_log.h"

#define TAG "SSD1306"
#define I2C_TIMEOUT_MS  100

static i2c_port_t s_port;
static uint8_t    s_addr;
static uint8_t    s_buf[SSD1306_WIDTH * SSD1306_HEIGHT / 8];
static uint8_t    s_col;
static uint8_t    s_row;  /* character row (0..7 for 64px height) */

/* 5x7 ASCII font, chars 0x20..0x7E */
static const uint8_t FONT5x7[][5] = {
    {0x00,0x00,0x00,0x00,0x00}, /* ' ' */
    {0x00,0x00,0x5F,0x00,0x00}, /* '!' */
    {0x00,0x07,0x00,0x07,0x00}, /* '"' */
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    {0x08,0x08,0x2A,0x1C,0x08}, /* '~' */
};

static esp_err_t write_cmd_buf(const uint8_t *cmds, size_t len)
{
    /* SSD1306: co=0, D/C#=0 means all following bytes are commands */
    uint8_t buf[32];
    if (len + 1 > sizeof(buf)) return ESP_ERR_INVALID_SIZE;
    buf[0] = 0x00; /* control byte: Co=0, D/C=0 */
    memcpy(&buf[1], cmds, len);
    return i2c_master_write_to_device(s_port, s_addr, buf, len + 1,
                                      pdMS_TO_TICKS(I2C_TIMEOUT_MS));
}

static esp_err_t write_cmd(uint8_t cmd)
{
    return write_cmd_buf(&cmd, 1);
}

static const uint8_t INIT_SEQ[] = {
    0xAE,       /* display off */
    0x20, 0x00, /* horizontal addressing */
    0xB0,       /* page start 0 */
    0xC8,       /* COM scan direction */
    0x00,       /* lower col start */
    0x10,       /* upper col start */
    0x40,       /* display start line 0 */
    0x81, 0xFF, /* contrast max */
    0xA1,       /* segment remap */
    0xA6,       /* normal display */
    0xA8, 0x3F, /* mux ratio 64 */
    0xA4,       /* output follows RAM */
    0xD3, 0x00, /* display offset 0 */
    0xD5, 0xF0, /* clock divide */
    0xD9, 0x22, /* pre-charge */
    0xDA, 0x12, /* COM pins */
    0xDB, 0x20, /* vcomh */
    0x8D, 0x14, /* charge pump on */
    0xAF,       /* display on */
};

bool ssd1306_init(i2c_port_t port, uint8_t addr)
{
    s_port = port;
    s_addr = addr;

    if (write_cmd_buf(INIT_SEQ, sizeof(INIT_SEQ)) != ESP_OK) {
        ESP_LOGE(TAG, "Init failed");
        return false;
    }
    memset(s_buf, 0, sizeof(s_buf));
    ssd1306_display();
    return true;
}

void ssd1306_clear(void)
{
    memset(s_buf, 0, sizeof(s_buf));
    s_col = 0;
    s_row = 0;
}

void ssd1306_display(void)
{
    /* Send one page (128 bytes) at a time: 1 control byte + 128 data bytes = 129 bytes */
    write_cmd(0x21); write_cmd(0); write_cmd(127);
    write_cmd(0x22); write_cmd(0); write_cmd(7);

    uint8_t buf[129];
    buf[0] = 0x40;
    for (int page = 0; page < 8; page++) {
        memcpy(&buf[1], &s_buf[page * SSD1306_WIDTH], SSD1306_WIDTH);
        i2c_master_write_to_device(s_port, s_addr, buf, sizeof(buf),
                                   pdMS_TO_TICKS(I2C_TIMEOUT_MS));
    }
}

void ssd1306_set_cursor(uint8_t col, uint8_t row)
{
    s_col = col;
    s_row = row;
}

void ssd1306_puts(const char *str)
{
    while (*str) {
        char c = *str++;
        if (c == '\n') {
            s_row++;
            s_col = 0;
            if (s_row >= SSD1306_HEIGHT / 8) break;
            continue;
        }
        if (c < 0x20 || c > 0x7E) c = '?';

        if (s_col + 6 > SSD1306_WIDTH) {
            s_row++;
            s_col = 0;
        }

        if (s_row >= SSD1306_HEIGHT / 8) break;

        const uint8_t *glyph = FONT5x7[c - 0x20];
        uint16_t page_offset = (uint16_t)s_row * SSD1306_WIDTH;

        for (int i = 0; i < 5; i++) {
            s_buf[page_offset + s_col + i] = glyph[i];
        }
        s_buf[page_offset + s_col + 5] = 0x00; /* char gap */
        s_col += 6;
    }
}

void ssd1306_printf(uint8_t col, uint8_t row, const char *fmt, ...)
{
    char tmp[64];
    va_list args;
    va_start(args, fmt);
    vsnprintf(tmp, sizeof(tmp), fmt, args);
    va_end(args);

    ssd1306_set_cursor(col, row);
    ssd1306_puts(tmp);
}
